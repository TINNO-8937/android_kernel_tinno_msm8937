
qcom,tinno-3200mah {
	/* #2726246_Tinno_I9051atl_3200mAh_averaged_MasterSlave_Dec27th2016*/
	qcom,max-voltage-uv = <4400000>;
	qcom,nom-batt-capacity-mah = <3200>;
	qcom,batt-id-kohm = <100>;
	qcom,battery-beta = <3435>;
	qcom,battery-type = "tinno-3200mah";
	qcom,chg-rslow-comp-c1 = <2642493>;
	qcom,chg-rslow-comp-c2 = <3683605>;
	qcom,chg-rs-to-rslow = <940349>;
	qcom,chg-rslow-comp-thr = <0xA3>;
	qcom,checksum = <0xB0BF>;
	qcom,gui-version = "PMI8950GUI - 2.0.0.16";
	qcom,fg-profile-data = [
		 F0 83 65 7D 
		 82 81 F9 77 
		 53 83 4A 59 
		 52 80 A7 87 
		 19 82 D6 9A 
		 4D BE E7 CB 
		 5A 0E FF 83 
		 8D 7D 94 81 
		 0A 7C 5A 83 
		 CD 58 6B 82 
		 C3 8E 7B 82 
		 E3 93 B0 B5 
		 87 C1 52 13 
		 E5 0C C8 59 
		 14 70 8B FD 
		 BF 3D 74 3D 
		 CF 38 00 00 
		 DB 45 FC 1B 
		 AF 31 00 00 
		 00 00 00 00 
		 00 00 00 00 
		 4C 70 D1 6B 
		 FB 71 DB 88 
		 36 74 08 62 
		 0C 5D 79 7A 
		 CD 6F 59 61 
		 EC 77 29 A2 
		 17 A2 62 6C 
		 64 A0 71 0C 
		 28 00 FF 36 
		 F0 11 30 03 
		 00 00 00 0C 
	];
};
