/* Copyright (c) 2015-2016, The Linux Foundation. All rights reserved.
 *
 * This program is free software; you can redistribute it and/or modify
 * it under the terms of the GNU General Public License version 2 and
 * only version 2 as published by the Free Software Foundation.
 *
 * This program is distributed in the hope that it will be useful,
 * but WITHOUT ANY WARRANTY; without even the implied warranty of
 * MERCHANTABILITY or FITNESS FOR A PARTICULAR PURPOSE.  See the
 * GNU General Public License for more details.
 */

&mdss_mdp {
	dsi_wd5eaf01_boe_1080_cmd: qcom,mdss_dsi_wd5ea5f01_boe_1080p_cmd {
//		qcom,cont-splash-enabled = <1>;
		qcom,mdss-dsi-panel-name = "wd5eaf01 boe 1080p cmd mode dsi panel";
		qcom,mdss-dsi-panel-controller = <&mdss_dsi0>;
		qcom,mdss-dsi-panel-destination = "display_1";
		qcom,mdss-dsi-panel-type = "dsi_cmd_mode";
		qcom,mdss-dsi-panel-framerate = <60>;
		qcom,mdss-dsi-virtual-channel-id = <0>;
		qcom,mdss-dsi-stream = <0>;
		qcom,mdss-dsi-panel-width = <1080>;
		qcom,mdss-dsi-panel-height = <1920>;
		qcom,mdss-dsi-h-front-porch = <20>;
		qcom,mdss-dsi-h-back-porch = <20>;
		qcom,mdss-dsi-h-pulse-width = <8>;
		qcom,mdss-dsi-h-sync-skew = <0>;
		qcom,mdss-dsi-v-back-porch = <7>;
		qcom,mdss-dsi-v-front-porch = <21>;
		qcom,mdss-dsi-v-pulse-width = <4>;
		qcom,mdss-dsi-h-left-border = <0>;
		qcom,mdss-dsi-h-right-border = <0>;
		qcom,mdss-dsi-v-top-border = <0>;
		qcom,mdss-dsi-v-bottom-border = <0>;
		qcom,mdss-dsi-bpp = <24>;
		qcom,mdss-dsi-underflow-color = <0xff>;
		qcom,mdss-dsi-border-color = <0>;
		qcom,mdss-dsi-te-pin-select = <1>;
		//qcom,mdss-dsi-te-dcs-command = <1>;
		qcom,mdss-dsi-te-check-enable;
		qcom,mdss-dsi-te-using-te-pin;
		qcom,mdss-dsi-h-sync-pulse = <1>;//0
		qcom,mdss-dsi-traffic-mode = "burst_mode";
		qcom,mdss-dsi-bllp-eof-power-mode;
		qcom,mdss-dsi-bllp-power-mode;

		qcom,mdss-dsi-hfp-power-mode;//
		qcom,mdss-dsi-hbp-power-mode;//
		qcom,mdss-dsi-hsa-power-mode;//
				
		qcom,mdss-dsi-lane-map = "lane_map_0123";
		qcom,mdss-dsi-lane-0-state;
		qcom,mdss-dsi-lane-1-state;
		qcom,mdss-dsi-lane-2-state;
		qcom,mdss-dsi-lane-3-state;
		qcom,mdss-dsi-panel-timings = [31 3E 11 14 0D 31 2A 11 14 0D 03 04];
		qcom,mdss-dsi-t-clk-post = <0x02>;
		qcom,mdss-dsi-t-clk-pre = <0x2c>;
		qcom,mdss-dsi-bl-min-level = <50>;
		qcom,mdss-dsi-bl-max-level = <255>;
		qcom,mdss-dsi-dma-trigger = "trigger_sw";
		qcom,mdss-dsi-mdp-trigger = "none";
		qcom,mdss-dsi-on-command = [05 01 00 00 1E 00 02 11 00
			39 01 00 00 00 00 03 F0 5A 5A
			39 01 00 00 00 00 03 F1 5A 5A
			39 01 00 00 00 00 08 E2 4C 00 00 00 30 00 00
			15 01 00 00 00 00 02 B2 00
			39 01 00 00 00 00 0A C7 A7 53 FF D8 B2 8C 5E 33 04
			39 01 00 00 00 00 08 B3 00 10 00 08 77 02 18
			39 01 00 00 00 00 03 44 07 C2
			39 01 00 00 00 00 07 BB E6 E8 E6 E8 B0 12
			15 01 00 00 00 00 02 35 00
			15 01 00 00 00 00 02 53 28
			15 01 00 00 80 00 02 51 00
			15 01 00 00 00 00 02 B0 01
			15 01 00 00 00 00 02 F6 00
			39 01 00 00 00 00 02 B0 04
			39 01 00 00 14 00 02 F6 51
			39 01 00 00 00 00 02 B0 04
			39 01 00 00 14 00 02 F6 3C
			39 01 00 00 00 00 02 B0 04
			39 01 00 00 14 00 02 F6 29
			05 01 00 00 0A 00 02 29 00];
		qcom,mdss-dsi-off-command = [05 01 00 00 32 00 02 28 00
				 05 01 00 00 78 00 02 10 00];
		qcom,mdss-dsi-on-command-state = "dsi_lp_mode";
		qcom,mdss-dsi-off-command-state = "dsi_lp_mode";
		qcom,mdss-dsi-panel-timings-phy-v2 = [23 1e 08 09 05 03 04 a0
				23 1e 08 09 05 03 04 a0
				23 1e 08 09 05 03 04 a0
				23 1e 08 09 05 03 04 a0
				23 1a 08 09 05 03 04 a0];
		qcom,esd-check-enabled;
		qcom,mdss-dsi-panel-status-check-mode = "te_signal_check";			
		qcom,mdss-dsi-bl-pmic-control-type = "bl_ctrl_dcs";
//		qcom,mdss-dsi-lp11-init;
		qcom,mdss-dsi-reset-sequence = <1 2>, <0 10>, <1 20>;
		qcom,mdss-pan-physical-width-dimension = <68>;
		qcom,mdss-pan-physical-height-dimension = <121>;
	};
};
