/* Copyright (c) 2014-2015, The Linux Foundation. All rights reserved.
 *
 * This program is free software; you can redistribute it and/or modify
 * it under the terms of the GNU General Public License version 2 and
 * only version 2 as published by the Free Software Foundation.
 *
 * This program is distributed in the hope that it will be useful,
 * but WITHOUT ANY WARRANTY; without even the implied warranty of
 * MERCHANTABILITY or FITNESS FOR A PARTICULAR PURPOSE.  See the
 * GNU General Public License for more details.
 */

&mdss_mdp {
	dsi_hx8399c_tcl_1080p_video:qcom,mdss_dsi_hx8399c_tcl_1080p_video{
		qcom,panel-supply-entries = <&dsi_panel_pwr_supply>;
		qcom,mdss-dsi-panel-name = "hx8399c_tcl_1080p_video";
		qcom,mdss-dsi-panel-controller = <&mdss_dsi0>;
		qcom,mdss-dsi-panel-type = "dsi_video_mode";
		qcom,mdss-dsi-panel-destination = "display_1";
		qcom,mdss-dsi-panel-framerate = <60>;
		qcom,mdss-dsi-virtual-channel-id = <0>;
		qcom,mdss-dsi-stream = <0>;
		qcom,mdss-dsi-panel-width = <1080>;
		qcom,mdss-dsi-panel-height = <1920>;
		qcom,mdss-dsi-h-front-porch = <102>;
		qcom,mdss-dsi-h-back-porch = <50>;
		qcom,mdss-dsi-h-pulse-width = <10>;
		qcom,mdss-dsi-h-sync-skew = <0>;
		qcom,mdss-dsi-v-back-porch = <4>;
		qcom,mdss-dsi-v-front-porch = <4>;
		qcom,mdss-dsi-v-pulse-width = <2>;
		qcom,mdss-dsi-h-left-border = <0>;
		qcom,mdss-dsi-h-right-border = <0>;
		qcom,mdss-dsi-v-top-border = <0>;
		qcom,mdss-dsi-v-bottom-border = <0>;
		qcom,mdss-dsi-bpp = <24>;
		qcom,mdss-dsi-color-order = "rgb_swap_rgb";
		qcom,mdss-dsi-underflow-color = <0xfffff>;
		qcom,mdss-dsi-border-color = <0>;
		qcom,mdss-dsi-on-command = [
					39 01 00 00 00 00 04 B9 FF 83 99
					39 01 00 00 00 00 05 BA 63 03 68 73
					39 01 00 00 00 00 10 B1 02 02 6D 8D 01 32 99 11 11 57 4D 56 73 02 02
					39 01 00 00 00 00 10 B2 00 88 00 AE 05 07 5A 14 00 10 00 1E 70 03 D3
					39 01 00 00 00 00 2E B4 04 FF 92 28 00 A4 00 00 0A 00 02 04 00 25 05 0C 0E 43 01 00 00 06 AF 88 90 48 00 AA 00 00 05 00 02 04 00 2C 02 04 08 00 00 02 AF 12 00
					39 01 00 00 00 00 28 D3 10 00 01 01 00 00 30 30 32 10 04 00 04 32 10 02 00 02 00 00 00 00 00 25 02 05 05 03 00 00 00 05 40 00 00 00 05 27 82
					39 01 00 00 00 00 21 D5 18 18 03 02 01 00 64 64 18 18 19 19 21 20 18 18 18 18 18 18 18 18 18 18 18 18 31 31 30 30 2F 2F
					39 01 00 00 00 00 21 D6 58 58 00 01 02 03 24 24 19 19 18 18 20 21 58 58 58 58 58 58 58 58 58 58 58 58 31 31 30 30 2F 2F
					39 01 00 00 00 00 11 D8 00 00 00 00 00 00 00 00 00 00 00 00 00 00 00 00
					39 01 00 00 00 00 02 BD 01
					39 01 00 00 00 00 11 D8 00 00 00 00 00 00 00 00 00 00 00 00 00 00 00 00
					39 01 00 00 00 00 02 BD 02
					39 01 00 00 00 00 09 D8 FF BF FF FF FF BF FF FF
					39 01 00 00 00 00 03 D3 00 14
					39 01 00 00 00 00 02 BD 00
					39 01 00 00 00 00 03 B6 85 85
					39 01 00 00 00 00 02 CC 08
					39 01 00 00 00 00 37 E0 01 19 24 1E 44 4C 5A 55 5D 66 6F 75 7A 81 88 8C 90 98 9A A1 95 A1 A5 56 52 5F 6D 01 19 24 1E 44 4C 5A 55 5D 66 6F 75 7A 81 88 8C 90 98 9A A1 95 A1 A5 56 52 5F 6D
					39 01 00 00 00 00 02 D9 84
					39 01 00 00 00 00 02 D2 88
					39 01 00 00 00 00 02 35 00
					05 01 00 00 78 00 02 11 00
					05 01 00 00 28 00 02 29 00];

		qcom,mdss-dsi-off-command = [
					05 01 00 00 32 00 02 28 00
					05 01 00 00 78 00 02 10 00];
		qcom,mdss-dsi-on-command-state = "dsi_lp_mode";
		qcom,mdss-dsi-off-command-state = "dsi_hs_mode";

		//add ESD check start
		qcom,esd-check-enabled;
		qcom,mdss-dsi-panel-status-command = [04 01 00 01 05 00 02 0A 08];
		qcom,mdss-dsi-panel-status-command-state = "dsi_lp_mode";
		qcom,mdss-dsi-panel-status-check-mode = "reg_read";
		qcom,mdss-dsi-panel-status-read-length = <1>;
		qcom,mdss-dsi-panel-status-value = <0x9d>;
		//add ESD check end

		qcom,mdss-dsi-h-sync-pulse = <1>;
		qcom,mdss-dsi-traffic-mode = "burst_mode";
		qcom,mdss-dsi-lane-map = "lane_map_0123";
		qcom,mdss-dsi-bllp-eof-power-mode;
		qcom,mdss-dsi-bllp-power-mode;
		qcom,mdss-dsi-lane-0-state;
		qcom,mdss-dsi-lane-1-state;
		qcom,mdss-dsi-lane-2-state;
		qcom,mdss-dsi-lane-3-state;
		qcom,mdss-dsi-panel-timings = [F9 3D 34 00 58 4D 36 3F 53 03 04 00];
		qcom,mdss-dsi-t-clk-post = <0x1f>;
		qcom,mdss-dsi-t-clk-pre = <0x2d>;
		qcom,mdss-dsi-bl-min-level = <1>;
		qcom,mdss-dsi-bl-max-level = <4095>;
		qcom,mdss-dsi-dma-trigger = "trigger_sw";
		qcom,mdss-dsi-mdp-trigger = "none";
		qcom,mdss-dsi-bl-pmic-control-type = "bl_ctrl_wled";
		qcom,mdss-dsi-reset-sequence = <1 10>, <0 10>, <1 10>;
		qcom,mdss-pan-physical-width-dimension = <59>;
		qcom,mdss-pan-physical-height-dimension = <104>;
	};
};
