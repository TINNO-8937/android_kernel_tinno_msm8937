/* Copyright (c) 2014-2015, The Linux Foundation. All rights reserved.
 *
 * This program is free software; you can redistribute it and/or modify
 * it under the terms of the GNU General Public License version 2 and
 * only version 2 as published by the Free Software Foundation.
 *
 * This program is distributed in the hope that it will be useful,
 * but WITHOUT ANY WARRANTY; without even the implied warranty of
 * MERCHANTABILITY or FITNESS FOR A PARTICULAR PURPOSE.  See the
 * GNU General Public License for more details.
 */

&mdss_mdp {
	dsi_nt35596_dijing_1080p_video:qcom,mdss_dsi_nt35596_dijing_1080p_video{
		qcom,panel-supply-entries = <&dsi_panel_pwr_supply>;
		qcom,mdss-dsi-panel-name = "nt35596_dijing_1080p_video";
		qcom,mdss-dsi-panel-controller = <&mdss_dsi0>;
		qcom,mdss-dsi-panel-type = "dsi_video_mode";
		qcom,mdss-dsi-panel-destination = "display_1";
		qcom,mdss-dsi-panel-framerate = <60>;
		qcom,mdss-dsi-virtual-channel-id = <0>;
		qcom,mdss-dsi-stream = <0>;
		qcom,mdss-dsi-panel-width = <1080>;
		qcom,mdss-dsi-panel-height = <1920>;
		qcom,mdss-dsi-h-front-porch = <102>;
		qcom,mdss-dsi-h-back-porch = <50>;
		qcom,mdss-dsi-h-pulse-width = <10>;
		qcom,mdss-dsi-h-sync-skew = <0>;
		qcom,mdss-dsi-v-back-porch = <4>;
		qcom,mdss-dsi-v-front-porch = <4>;
		qcom,mdss-dsi-v-pulse-width = <2>;
		qcom,mdss-dsi-h-left-border = <0>;
		qcom,mdss-dsi-h-right-border = <0>;
		qcom,mdss-dsi-v-top-border = <0>;
		qcom,mdss-dsi-v-bottom-border = <0>;
		qcom,mdss-dsi-bpp = <24>;
		qcom,mdss-dsi-color-order = "rgb_swap_rgb";
		qcom,mdss-dsi-underflow-color = <0xfffff>;
		qcom,mdss-dsi-border-color = <0>;
		qcom,mdss-dsi-on-command = [
					29 01 00 00 00 00 02 FF 00
					29 01 00 00 00 00 02 D3 06
					29 01 00 00 00 00 02 D4 04
					29 01 00 00 00 00 02 35 00
					29 01 00 00 00 00 02 FF EE
					29 01 00 00 42 00 02 18 40
					29 01 00 00 64 00 02 18 00
					29 01 00 00 00 00 02 FF 01
					29 01 00 00 00 00 02 FB 01
					29 01 00 00 00 00 02 00 01
					29 01 00 00 00 00 02 01 55
					29 01 00 00 00 00 02 05 40
					29 01 00 00 00 00 02 06 0A
					29 01 00 00 00 00 02 07 99
					29 01 00 00 00 00 02 08 0C
					29 01 00 00 00 00 02 0B 7D
					29 01 00 00 00 00 02 0C 69
					29 01 00 00 00 00 02 0E AF
					29 01 00 00 00 00 02 0F 9C
					29 01 00 00 00 00 02 14 A9
					29 01 00 00 00 00 02 15 9A
					29 01 00 00 00 00 02 16 9A
					29 01 00 00 00 00 02 58 80
					29 01 00 00 00 00 02 59 00
					29 01 00 00 00 00 02 5A 00
					29 01 00 00 00 00 02 5B 00
					29 01 00 00 00 00 02 5C 80
					29 01 00 00 00 00 02 5D 05
					29 01 00 00 00 00 02 5E 00
					29 01 00 00 00 00 02 5F 02
					29 01 00 00 00 00 02 69 99
					29 01 00 00 00 00 02 6D 66
					29 01 00 00 00 00 02 68 13
					29 01 00 00 00 00 02 FF 05
					29 01 00 00 00 00 02 FB 01
					29 01 00 00 00 00 02 00 00
					29 01 00 00 00 00 02 01 03
					29 01 00 00 00 00 02 02 05
					29 01 00 00 00 00 02 03 00
					29 01 00 00 00 00 02 04 00
					29 01 00 00 00 00 02 05 0B
					29 01 00 00 00 00 02 06 0C
					29 01 00 00 00 00 02 07 01
					29 01 00 00 00 00 02 08 00
					29 01 00 00 00 00 02 09 00
					29 01 00 00 00 00 02 0A 00
					29 01 00 00 00 00 02 0B 00
					29 01 00 00 00 00 02 0C 00
					29 01 00 00 00 00 02 0D 17
					29 01 00 00 00 00 02 0E 15
					29 01 00 00 00 00 02 0F 13
					29 01 00 00 00 00 02 10 00
					29 01 00 00 00 00 02 11 04
					29 01 00 00 00 00 02 12 06
					29 01 00 00 00 00 02 13 00
					29 01 00 00 00 00 02 14 00
					29 01 00 00 00 00 02 15 00
					29 01 00 00 00 00 02 16 0F
					29 01 00 00 00 00 02 17 01
					29 01 00 00 00 00 02 18 10
					29 01 00 00 00 00 02 19 90
					29 01 00 00 00 00 02 1A 00
					29 01 00 00 00 00 02 1B 00
					29 01 00 00 00 00 02 1C 00
					29 01 00 00 00 00 02 1D 17
					29 01 00 00 00 00 02 1E 15
					29 01 00 00 00 00 02 1F 13
					29 01 00 00 00 00 02 20 05
					29 01 00 00 00 00 02 21 01
					29 01 00 00 00 00 02 22 01
					29 01 00 00 00 00 02 23 00
					29 01 00 00 00 00 02 24 73
					29 01 00 00 00 00 02 25 DD
					29 01 00 00 00 00 02 29 D0
					29 01 00 00 00 00 02 2A 2B
					29 01 00 00 00 00 02 2B 0A
					29 01 00 00 00 00 02 2F 02
					29 01 00 00 00 00 02 30 02
					29 01 00 00 00 00 02 31 00
					29 01 00 00 00 00 02 32 6A
					29 01 00 00 00 00 02 33 00
					29 01 00 00 00 00 02 34 06
					29 01 00 00 00 00 02 35 6A
					29 01 00 00 00 00 02 36 00
					29 01 00 00 00 00 02 37 1D
					29 01 00 00 00 00 02 38 18
					29 01 00 00 00 00 02 5B 04
					29 01 00 00 00 00 02 5C 00
					29 01 00 00 00 00 02 5F 75
					29 01 00 00 00 00 02 60 6D
					29 01 00 00 00 00 02 63 00
					29 01 00 00 00 00 02 64 01
					29 01 00 00 00 00 02 67 04
					29 01 00 00 00 00 02 68 00
					29 01 00 00 00 00 02 6C 45
					29 01 00 00 00 00 02 7A 80
					29 01 00 00 00 00 02 7B A2
					29 01 00 00 00 00 02 7C D8
					29 01 00 00 00 00 02 7D 50
					29 01 00 00 00 00 02 7E 08
					29 01 00 00 00 00 02 7F 19
					29 01 00 00 00 00 02 80 0B
					29 01 00 00 00 00 02 81 08
					29 01 00 00 00 00 02 82 01
					29 01 00 00 00 00 02 83 00
					29 01 00 00 00 00 02 84 03
					29 01 00 00 00 00 02 85 05
					29 01 00 00 00 00 02 86 36
					29 01 00 00 00 00 02 87 36
					29 01 00 00 00 00 02 88 36
					29 01 00 00 00 00 02 89 36
					29 01 00 00 00 00 02 8A 33
					29 01 00 00 00 00 02 8B 00
					29 01 00 00 00 00 02 90 00
					29 01 00 00 00 00 02 91 44
					29 01 00 00 00 00 02 92 77
					29 01 00 00 00 00 02 93 04
					29 01 00 00 00 00 02 94 06
					29 01 00 00 00 00 02 99 00
					29 01 00 00 00 00 02 9B 0F
					29 01 00 00 00 00 02 9C 00
					29 01 00 00 00 00 02 9D B0
					29 01 00 00 00 00 02 A4 0F
					29 01 00 00 00 00 02 BA A3
					29 01 00 00 00 00 02 C4 27
					29 01 00 00 00 00 02 C5 36
					29 01 00 00 00 00 02 C6 09
					29 01 00 00 00 00 02 C7 00
					29 01 00 00 00 00 02 C8 10
					29 01 00 00 00 00 02 C9 00
					29 01 00 00 00 00 02 CA 01
					29 01 00 00 00 00 02 CF 00
					29 01 00 00 00 00 02 D0 01
					29 01 00 00 00 00 02 E7 80
/*   
					29 01 00 00 00 00 02 FF 01
					29 01 00 00 00 00 02 FB 01
					29 01 00 00 00 00 02 75 00
					29 01 00 00 00 00 02 76 00
					29 01 00 00 00 00 02 77 00
					29 01 00 00 00 00 02 78 36
					29 01 00 00 00 00 02 79 00
					29 01 00 00 00 00 02 7A 63
					29 01 00 00 00 00 02 7B 00
					29 01 00 00 00 00 02 7C 81
					29 01 00 00 00 00 02 7D 00
					29 01 00 00 00 00 02 7E 99
					29 01 00 00 00 00 02 7F 00
					29 01 00 00 00 00 02 80 AD
					29 01 00 00 00 00 02 81 00
					29 01 00 00 00 00 02 82 BE
					29 01 00 00 00 00 02 83 00
					29 01 00 00 00 00 02 84 CD
					29 01 00 00 00 00 02 85 00
					29 01 00 00 00 00 02 86 DB
					29 01 00 00 00 00 02 87 01
					29 01 00 00 00 00 02 88 09
					29 01 00 00 00 00 02 89 01
					29 01 00 00 00 00 02 8A 2D
					29 01 00 00 00 00 02 8B 01
					29 01 00 00 00 00 02 8C 67
					29 01 00 00 00 00 02 8D 01
					29 01 00 00 00 00 02 8E 95
					29 01 00 00 00 00 02 8F 01
					29 01 00 00 00 00 02 90 DC
					29 01 00 00 00 00 02 91 02
					29 01 00 00 00 00 02 92 14
					29 01 00 00 00 00 02 93 02
					29 01 00 00 00 00 02 94 15
					29 01 00 00 00 00 02 95 02
					29 01 00 00 00 00 02 96 48
					29 01 00 00 00 00 02 97 02
					29 01 00 00 00 00 02 98 7E
					29 01 00 00 00 00 02 99 02
					29 01 00 00 00 00 02 9A A0
					29 01 00 00 00 00 02 9B 02
					29 01 00 00 00 00 02 9C CF
					29 01 00 00 00 00 02 9D 02
					29 01 00 00 00 00 02 9E F0
					29 01 00 00 00 00 02 9F 03
					29 01 00 00 00 00 02 A0 1C
					29 01 00 00 00 00 02 A2 03
					29 01 00 00 00 00 02 A3 2A
					29 01 00 00 00 00 02 A4 03
					29 01 00 00 00 00 02 A5 3A
					29 01 00 00 00 00 02 A6 03
					29 01 00 00 00 00 02 A7 4B
					29 01 00 00 00 00 02 A9 03
					29 01 00 00 00 00 02 AA 5E
					29 01 00 00 00 00 02 AB 03
					29 01 00 00 00 00 02 AC 75
					29 01 00 00 00 00 02 AD 03
					29 01 00 00 00 00 02 AE 90
					29 01 00 00 00 00 02 AF 03
					29 01 00 00 00 00 02 B0 B1
					29 01 00 00 00 00 02 B1 03
					29 01 00 00 00 00 02 B2 E3
					29 01 00 00 00 00 02 B3 00
					29 01 00 00 00 00 02 B4 00
					29 01 00 00 00 00 02 B5 00
					29 01 00 00 00 00 02 B6 36
					29 01 00 00 00 00 02 B7 00
					29 01 00 00 00 00 02 B8 63
					29 01 00 00 00 00 02 B9 00
					29 01 00 00 00 00 02 BA 81
					29 01 00 00 00 00 02 BB 00
					29 01 00 00 00 00 02 BC 99
					29 01 00 00 00 00 02 BD 00
					29 01 00 00 00 00 02 BE AD
					29 01 00 00 00 00 02 BF 00
					29 01 00 00 00 00 02 C0 BE
					29 01 00 00 00 00 02 C1 00
					29 01 00 00 00 00 02 C2 CD
					29 01 00 00 00 00 02 C3 00
					29 01 00 00 00 00 02 C4 DB
					29 01 00 00 00 00 02 C5 01
					29 01 00 00 00 00 02 C6 09
					29 01 00 00 00 00 02 C7 01
					29 01 00 00 00 00 02 C8 2D
					29 01 00 00 00 00 02 C9 01
					29 01 00 00 00 00 02 CA 67
					29 01 00 00 00 00 02 CB 01
					29 01 00 00 00 00 02 CC 95
					29 01 00 00 00 00 02 CD 01
					29 01 00 00 00 00 02 CE DC
					29 01 00 00 00 00 02 CF 02
					29 01 00 00 00 00 02 D0 14
					29 01 00 00 00 00 02 D1 02
					29 01 00 00 00 00 02 D2 15
					29 01 00 00 00 00 02 D3 02
					29 01 00 00 00 00 02 D4 48
					29 01 00 00 00 00 02 D5 02
					29 01 00 00 00 00 02 D6 7E
					29 01 00 00 00 00 02 D7 02
					29 01 00 00 00 00 02 D8 A0
					29 01 00 00 00 00 02 D9 02
					29 01 00 00 00 00 02 DA CF
					29 01 00 00 00 00 02 DB 02
					29 01 00 00 00 00 02 DC F0
					29 01 00 00 00 00 02 DD 03
					29 01 00 00 00 00 02 DE 1C
					29 01 00 00 00 00 02 DF 03
					29 01 00 00 00 00 02 E0 2A
					29 01 00 00 00 00 02 E1 03
					29 01 00 00 00 00 02 E2 3A
					29 01 00 00 00 00 02 E3 03
					29 01 00 00 00 00 02 E4 4B
					29 01 00 00 00 00 02 E5 03
					29 01 00 00 00 00 02 E6 5E
					29 01 00 00 00 00 02 E7 03
					29 01 00 00 00 00 02 E8 75
					29 01 00 00 00 00 02 E9 03
					29 01 00 00 00 00 02 EA 90
					29 01 00 00 00 00 02 EB 03
					29 01 00 00 00 00 02 EC B1
					29 01 00 00 00 00 02 ED 03
					29 01 00 00 00 00 02 EE E3
					29 01 00 00 00 00 02 EF 00
					29 01 00 00 00 00 02 F0 00
					29 01 00 00 00 00 02 F1 00
					29 01 00 00 00 00 02 F2 36
					29 01 00 00 00 00 02 F3 00
					29 01 00 00 00 00 02 F4 63
					29 01 00 00 00 00 02 F5 00
					29 01 00 00 00 00 02 F6 81
					29 01 00 00 00 00 02 F7 00
					29 01 00 00 00 00 02 F8 99
					29 01 00 00 00 00 02 F9 00
					29 01 00 00 00 00 02 FA AD
					29 01 00 00 00 00 02 FF 02
					29 01 00 00 00 00 02 FB 01
					29 01 00 00 00 00 02 00 00
					29 01 00 00 00 00 02 01 BE
					29 01 00 00 00 00 02 02 00
					29 01 00 00 00 00 02 03 CD
					29 01 00 00 00 00 02 04 00
					29 01 00 00 00 00 02 05 DB
					29 01 00 00 00 00 02 06 01
					29 01 00 00 00 00 02 07 09
					29 01 00 00 00 00 02 08 01
					29 01 00 00 00 00 02 09 2D
					29 01 00 00 00 00 02 0A 01
					29 01 00 00 00 00 02 0B 67
					29 01 00 00 00 00 02 0C 01
					29 01 00 00 00 00 02 0D 95
					29 01 00 00 00 00 02 0E 01
					29 01 00 00 00 00 02 0F DC
					29 01 00 00 00 00 02 10 02
					29 01 00 00 00 00 02 11 14
					29 01 00 00 00 00 02 12 02
					29 01 00 00 00 00 02 13 15
					29 01 00 00 00 00 02 14 02
					29 01 00 00 00 00 02 15 48
					29 01 00 00 00 00 02 16 02
					29 01 00 00 00 00 02 17 7E
					29 01 00 00 00 00 02 18 02
					29 01 00 00 00 00 02 19 A0
					29 01 00 00 00 00 02 1A 02
					29 01 00 00 00 00 02 1B CF
					29 01 00 00 00 00 02 1C 02
					29 01 00 00 00 00 02 1D F0
					29 01 00 00 00 00 02 1E 03
					29 01 00 00 00 00 02 1F 1C
					29 01 00 00 00 00 02 20 03
					29 01 00 00 00 00 02 21 2A
					29 01 00 00 00 00 02 22 03
					29 01 00 00 00 00 02 23 3A
					29 01 00 00 00 00 02 24 03
					29 01 00 00 00 00 02 25 4B
					29 01 00 00 00 00 02 26 03
					29 01 00 00 00 00 02 27 5E
					29 01 00 00 00 00 02 28 03
					29 01 00 00 00 00 02 29 75
					29 01 00 00 00 00 02 2A 03
					29 01 00 00 00 00 02 2B 90
					29 01 00 00 00 00 02 2D 03
					29 01 00 00 00 00 02 2F B1
					29 01 00 00 00 00 02 30 03
					29 01 00 00 00 00 02 31 E3
					29 01 00 00 00 00 02 32 00
					29 01 00 00 00 00 02 33 00
					29 01 00 00 00 00 02 34 00
					29 01 00 00 00 00 02 35 36
					29 01 00 00 00 00 02 36 00
					29 01 00 00 00 00 02 37 63
					29 01 00 00 00 00 02 38 00
					29 01 00 00 00 00 02 39 81
					29 01 00 00 00 00 02 3A 00
					29 01 00 00 00 00 02 3B 99
					29 01 00 00 00 00 02 3D 00
					29 01 00 00 00 00 02 3F AD
					29 01 00 00 00 00 02 40 00
					29 01 00 00 00 00 02 41 BE
					29 01 00 00 00 00 02 42 00
					29 01 00 00 00 00 02 43 CD
					29 01 00 00 00 00 02 44 00
					29 01 00 00 00 00 02 45 DB
					29 01 00 00 00 00 02 46 01
					29 01 00 00 00 00 02 47 09
					29 01 00 00 00 00 02 48 01
					29 01 00 00 00 00 02 49 2D
					29 01 00 00 00 00 02 4A 01
					29 01 00 00 00 00 02 4B 67
					29 01 00 00 00 00 02 4C 01
					29 01 00 00 00 00 02 4D 95
					29 01 00 00 00 00 02 4E 01
					29 01 00 00 00 00 02 4F DC
					29 01 00 00 00 00 02 50 02
					29 01 00 00 00 00 02 51 14
					29 01 00 00 00 00 02 52 02
					29 01 00 00 00 00 02 53 15
					29 01 00 00 00 00 02 54 02
					29 01 00 00 00 00 02 55 48
					29 01 00 00 00 00 02 56 02
					29 01 00 00 00 00 02 58 7E
					29 01 00 00 00 00 02 59 02
					29 01 00 00 00 00 02 5A A0
					29 01 00 00 00 00 02 5B 02
					29 01 00 00 00 00 02 5C CF
					29 01 00 00 00 00 02 5D 02
					29 01 00 00 00 00 02 5E F0
					29 01 00 00 00 00 02 5F 03
					29 01 00 00 00 00 02 60 1C
					29 01 00 00 00 00 02 61 03
					29 01 00 00 00 00 02 62 2A
					29 01 00 00 00 00 02 63 03
					29 01 00 00 00 00 02 64 3A
					29 01 00 00 00 00 02 65 03
					29 01 00 00 00 00 02 66 4B
					29 01 00 00 00 00 02 67 03
					29 01 00 00 00 00 02 68 5E
					29 01 00 00 00 00 02 69 03
					29 01 00 00 00 00 02 6A 75
					29 01 00 00 00 00 02 6B 03
					29 01 00 00 00 00 02 6C 90
					29 01 00 00 00 00 02 6D 03
					29 01 00 00 00 00 02 6E B1
					29 01 00 00 00 00 02 6F 03
					29 01 00 00 00 00 02 70 E3
					29 01 00 00 00 00 02 71 00
					29 01 00 00 00 00 02 72 00
					29 01 00 00 00 00 02 73 00
					29 01 00 00 00 00 02 74 36
					29 01 00 00 00 00 02 75 00
					29 01 00 00 00 00 02 76 63
					29 01 00 00 00 00 02 77 00
					29 01 00 00 00 00 02 78 81
					29 01 00 00 00 00 02 79 00
					29 01 00 00 00 00 02 7A 99
					29 01 00 00 00 00 02 7B 00
					29 01 00 00 00 00 02 7C AD
					29 01 00 00 00 00 02 7D 00
					29 01 00 00 00 00 02 7E BE
					29 01 00 00 00 00 02 7F 00
					29 01 00 00 00 00 02 80 CD
					29 01 00 00 00 00 02 81 00
					29 01 00 00 00 00 02 82 DB
					29 01 00 00 00 00 02 83 01
					29 01 00 00 00 00 02 84 09
					29 01 00 00 00 00 02 85 01
					29 01 00 00 00 00 02 86 2D
					29 01 00 00 00 00 02 87 01
					29 01 00 00 00 00 02 88 67
					29 01 00 00 00 00 02 89 01
					29 01 00 00 00 00 02 8A 95
					29 01 00 00 00 00 02 8B 01
					29 01 00 00 00 00 02 8C DC
					29 01 00 00 00 00 02 8D 02
					29 01 00 00 00 00 02 8E 14
					29 01 00 00 00 00 02 8F 02
					29 01 00 00 00 00 02 90 15
					29 01 00 00 00 00 02 91 02
					29 01 00 00 00 00 02 92 48
					29 01 00 00 00 00 02 93 02
					29 01 00 00 00 00 02 94 7E
					29 01 00 00 00 00 02 95 02
					29 01 00 00 00 00 02 96 A0
					29 01 00 00 00 00 02 97 02
					29 01 00 00 00 00 02 98 CF
					29 01 00 00 00 00 02 99 02
					29 01 00 00 00 00 02 9A F0
					29 01 00 00 00 00 02 9B 03
					29 01 00 00 00 00 02 9C 1C
					29 01 00 00 00 00 02 9D 03
					29 01 00 00 00 00 02 9E 2A
					29 01 00 00 00 00 02 9F 03
					29 01 00 00 00 00 02 A0 3A
					29 01 00 00 00 00 02 A2 03
					29 01 00 00 00 00 02 A3 4B
					29 01 00 00 00 00 02 A4 03
					29 01 00 00 00 00 02 A5 5E
					29 01 00 00 00 00 02 A6 03
					29 01 00 00 00 00 02 A7 75
					29 01 00 00 00 00 02 A9 03
					29 01 00 00 00 00 02 AA 90
					29 01 00 00 00 00 02 AB 03
					29 01 00 00 00 00 02 AC B1
					29 01 00 00 00 00 02 AD 03
					29 01 00 00 00 00 02 AE E3
					29 01 00 00 00 00 02 AF 00
					29 01 00 00 00 00 02 B0 00
					29 01 00 00 00 00 02 B1 00
					29 01 00 00 00 00 02 B2 36
					29 01 00 00 00 00 02 B3 00
					29 01 00 00 00 00 02 B4 63
					29 01 00 00 00 00 02 B5 00
					29 01 00 00 00 00 02 B6 81
					29 01 00 00 00 00 02 B7 00
					29 01 00 00 00 00 02 B8 99
					29 01 00 00 00 00 02 B9 00
					29 01 00 00 00 00 02 BA AD
					29 01 00 00 00 00 02 BB 00
					29 01 00 00 00 00 02 BC BE
					29 01 00 00 00 00 02 BD 00
					29 01 00 00 00 00 02 BE CD
					29 01 00 00 00 00 02 BF 00
					29 01 00 00 00 00 02 C0 DB
					29 01 00 00 00 00 02 C1 01
					29 01 00 00 00 00 02 C2 09
					29 01 00 00 00 00 02 C3 01
					29 01 00 00 00 00 02 C4 2D
					29 01 00 00 00 00 02 C5 01
					29 01 00 00 00 00 02 C6 67
					29 01 00 00 00 00 02 C7 01
					29 01 00 00 00 00 02 C8 95
					29 01 00 00 00 00 02 C9 01
					29 01 00 00 00 00 02 CA DC
					29 01 00 00 00 00 02 CB 02
					29 01 00 00 00 00 02 CC 14
					29 01 00 00 00 00 02 CD 02
					29 01 00 00 00 00 02 CE 15
					29 01 00 00 00 00 02 CF 02
					29 01 00 00 00 00 02 D0 48
					29 01 00 00 00 00 02 D1 02
					29 01 00 00 00 00 02 D2 7E
					29 01 00 00 00 00 02 D3 02
					29 01 00 00 00 00 02 D4 A0
					29 01 00 00 00 00 02 D5 02
					29 01 00 00 00 00 02 D6 CF
					29 01 00 00 00 00 02 D7 02
					29 01 00 00 00 00 02 D8 F0
					29 01 00 00 00 00 02 D9 03
					29 01 00 00 00 00 02 DA 1C
					29 01 00 00 00 00 02 DB 03
					29 01 00 00 00 00 02 DC 2A
					29 01 00 00 00 00 02 DD 03
					29 01 00 00 00 00 02 DE 3A
					29 01 00 00 00 00 02 DF 03
					29 01 00 00 00 00 02 E0 4B
					29 01 00 00 00 00 02 E1 03
					29 01 00 00 00 00 02 E2 5E
					29 01 00 00 00 00 02 E3 03
					29 01 00 00 00 00 02 E4 75
					29 01 00 00 00 00 02 E5 03
					29 01 00 00 00 00 02 E6 90
					29 01 00 00 00 00 02 E7 03
					29 01 00 00 00 00 02 E8 B1
					29 01 00 00 00 00 02 E9 03
					29 01 00 00 00 00 02 EA E3
*/
					29 01 00 00 00 00 02 FF 00
					05 01 00 00 78 00 02 11 00
					05 01 00 00 28 00 02 29 00];

		qcom,mdss-dsi-off-command = [
					05 01 00 00 32 00 02 28 00
					05 01 00 00 78 00 02 10 00];
		qcom,mdss-dsi-on-command-state = "dsi_lp_mode";
		qcom,mdss-dsi-off-command-state = "dsi_hs_mode";

		//add ESD check start
		qcom,esd-check-enabled;
		qcom,mdss-dsi-panel-status-command = [06 01 00 01 05 00 02 0A 08];
		qcom,mdss-dsi-panel-status-command-state = "dsi_lp_mode";
		qcom,mdss-dsi-panel-status-check-mode = "reg_read";
		qcom,mdss-dsi-panel-status-read-length = <1>;
		qcom,mdss-dsi-panel-status-value = <0x9c>;
		//add ESD check end

		qcom,mdss-dsi-h-sync-pulse = <1>;
		qcom,mdss-dsi-traffic-mode = "burst_mode";
		qcom,mdss-dsi-lane-map = "lane_map_0123";
		qcom,mdss-dsi-bllp-eof-power-mode;
		qcom,mdss-dsi-bllp-power-mode;
		qcom,mdss-dsi-lane-0-state;
		qcom,mdss-dsi-lane-1-state;
		qcom,mdss-dsi-lane-2-state;
		qcom,mdss-dsi-lane-3-state;
		qcom,mdss-dsi-panel-timings = [F9 3D 34 00 58 4D 36 3F 53 03 04 00];
		qcom,mdss-dsi-t-clk-post = <0x1f>;
		qcom,mdss-dsi-t-clk-pre = <0x2d>;
		qcom,mdss-dsi-bl-min-level = <1>;
		qcom,mdss-dsi-bl-max-level = <4095>;
		qcom,mdss-dsi-dma-trigger = "trigger_sw";
		qcom,mdss-dsi-mdp-trigger = "none";
		qcom,mdss-dsi-bl-pmic-control-type = "bl_ctrl_wled";
		qcom,mdss-dsi-reset-sequence = <1 10>, <0 10>, <1 10>;
		qcom,mdss-pan-physical-width-dimension = <59>;
		qcom,mdss-pan-physical-height-dimension = <104>;
	};
};
