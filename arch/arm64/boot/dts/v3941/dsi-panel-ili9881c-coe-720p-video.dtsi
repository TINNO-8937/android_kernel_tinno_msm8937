/* Copyright (c) 2013, The Linux Foundation. All rights reserved.
 *
 * This program is free software; you can redistribute it and/or modify
 * it under the terms of the GNU General Public License version 2 and
 * only version 2 as published by the Free Software Foundation.
 *
 * This program is distributed in the hope that it will be useful,
 * but WITHOUT ANY WARRANTY; without even the implied warranty of
 * MERCHANTABILITY or FITNESS FOR A PARTICULAR PURPOSE.  See the
 * GNU General Public License for more details.
 */

/*---------------------------------------------------------------------------
 * This file is autogenerated file using gcdb parser. Please do not edit it.
 * Update input XML file to add a new entry or update variable in this file
 * VERSION = "1.0"
 *---------------------------------------------------------------------------*/
&mdss_mdp {
	dsi_ili9881c_coe_vid: qcom,mdss_dsi_ili9881c_coe_vid {
		qcom,mdss-dsi-panel-name = "ili9881c coe 720p video mode dsi panel";
		qcom,mdss-dsi-panel-type = "dsi_video_mode";
		qcom,mdss-dsi-panel-framerate = <60>;
		qcom,mdss-dsi-virtual-channel-id = <0>;
		qcom,mdss-dsi-stream = <0>;
		qcom,mdss-dsi-panel-width = <720>;
		qcom,mdss-dsi-panel-height = <1280>;
		qcom,mdss-dsi-h-front-porch = <60>;
		qcom,mdss-dsi-h-back-porch = <30>;
		qcom,mdss-dsi-h-pulse-width = <30>;
		qcom,mdss-dsi-h-sync-skew = <0>;
		qcom,mdss-dsi-v-back-porch = <14>;
		qcom,mdss-dsi-v-front-porch = <10>;
		qcom,mdss-dsi-v-pulse-width = <6>;
		qcom,mdss-dsi-h-left-border = <0>;
		qcom,mdss-dsi-h-right-border = <0>;
		qcom,mdss-dsi-v-top-border = <0>;
		qcom,mdss-dsi-v-bottom-border = <0>;
		qcom,mdss-dsi-bpp = <24>;
		qcom,mdss-dsi-underflow-color = <0xff>;
		qcom,mdss-dsi-border-color = <0>;
		qcom,mdss-dsi-h-sync-pulse = <0>;
		qcom,mdss-dsi-traffic-mode = "burst_mode";
		qcom,mdss-dsi-bllp-eof-power-mode;
		qcom,mdss-dsi-bllp-power-mode;
		qcom,mdss-dsi-lane-0-state;
		qcom,mdss-dsi-lane-1-state;
		qcom,mdss-dsi-lane-2-state;
		qcom,mdss-dsi-lane-3-state;
		qcom,mdss-dsi-panel-timings = [78 1C 12 00 42 44 18 20 16 03 04 00];
		qcom,mdss-dsi-t-clk-post = <0x04>;
		qcom,mdss-dsi-t-clk-pre = <0x1b>;
		qcom,mdss-dsi-bl-min-level = <1>;
		qcom,mdss-dsi-bl-max-level = <4095>;
		qcom,mdss-dsi-dma-trigger = "trigger_sw";
		qcom,mdss-dsi-mdp-trigger = "none";
		qcom,mdss-dsi-on-command = [
		  39 01 00 00 00 00 04 FF 98 81 03        
			15 01 00 00 00 00 02 01 00
      15 01 00 00 00 00 02 02 00
      15 01 00 00 00 00 02 03 73
      15 01 00 00 00 00 02 04 73
      15 01 00 00 00 00 02 05 00
      15 01 00 00 00 00 02 06 06
      15 01 00 00 00 00 02 07 02
      15 01 00 00 00 00 02 08 00
      15 01 00 00 00 00 02 09 01
      15 01 00 00 00 00 02 0a 01
      15 01 00 00 00 00 02 0b 01
      15 01 00 00 00 00 02 0c 01
      15 01 00 00 00 00 02 0d 01
      15 01 00 00 00 00 02 0e 01
      15 01 00 00 00 00 02 0f 01      
      15 01 00 00 00 00 02 10 01       
      15 01 00 00 00 00 02 11 00
      15 01 00 00 00 00 02 12 00
      15 01 00 00 00 00 02 13 01
      15 01 00 00 00 00 02 14 00
      15 01 00 00 00 00 02 15 00
      15 01 00 00 00 00 02 16 00 
      15 01 00 00 00 00 02 17 00
      15 01 00 00 00 00 02 18 00
      15 01 00 00 00 00 02 19 00
      15 01 00 00 00 00 02 1a 00
      15 01 00 00 00 00 02 1b 00
      15 01 00 00 00 00 02 1c 00
      15 01 00 00 00 00 02 1d 00
      15 01 00 00 00 00 02 1e C0
      15 01 00 00 00 00 02 1f 80
      15 01 00 00 00 00 02 20 04
      15 01 00 00 00 00 02 21 03
      15 01 00 00 00 00 02 22 00
      15 01 00 00 00 00 02 23 00
      15 01 00 00 00 00 02 24 00
      15 01 00 00 00 00 02 25 00
      15 01 00 00 00 00 02 26 00
      15 01 00 00 00 00 02 27 00
      15 01 00 00 00 00 02 28 33
      15 01 00 00 00 00 02 29 03
      15 01 00 00 00 00 02 2a 00
      15 01 00 00 00 00 02 2b 00
      15 01 00 00 00 00 02 2c 00
      15 01 00 00 00 00 02 2d 00
      15 01 00 00 00 00 02 2e 00
      15 01 00 00 00 00 02 2f 00
      15 01 00 00 00 00 02 30 00
      15 01 00 00 00 00 02 31 00
      15 01 00 00 00 00 02 32 00
      15 01 00 00 00 00 02 33 00  
      15 01 00 00 00 00 02 34 03
      15 01 00 00 00 00 02 35 00
      15 01 00 00 00 00 02 36 03
      15 01 00 00 00 00 02 37 00
      15 01 00 00 00 00 02 38 00
      15 01 00 00 00 00 02 39 00
      15 01 00 00 00 00 02 3a 00 
      15 01 00 00 00 00 02 3b 00
      15 01 00 00 00 00 02 3c 00
      15 01 00 00 00 00 02 3d 00
      15 01 00 00 00 00 02 3e 00
      15 01 00 00 00 00 02 3f 00
      15 01 00 00 00 00 02 40 00
      15 01 00 00 00 00 02 41 00
      15 01 00 00 00 00 02 42 00
      15 01 00 00 00 00 02 43 00 
      15 01 00 00 00 00 02 44 00
                              
                      
      15 01 00 00 00 00 02 50 01
      15 01 00 00 00 00 02 51 23
      15 01 00 00 00 00 02 52 45
      15 01 00 00 00 00 02 53 67
      15 01 00 00 00 00 02 54 89
      15 01 00 00 00 00 02 55 ab
      15 01 00 00 00 00 02 56 01
      15 01 00 00 00 00 02 57 23
      15 01 00 00 00 00 02 58 45
      15 01 00 00 00 00 02 59 67
      15 01 00 00 00 00 02 5a 89
      15 01 00 00 00 00 02 5b ab
      15 01 00 00 00 00 02 5c cd
      15 01 00 00 00 00 02 5d ef
                              
                      
      15 01 00 00 00 00 02 5e 10
      15 01 00 00 00 00 02 5f 09
      15 01 00 00 00 00 02 60 08
      15 01 00 00 00 00 02 61 0F
      15 01 00 00 00 00 02 62 0E
      15 01 00 00 00 00 02 63 0D
      15 01 00 00 00 00 02 64 0C
      15 01 00 00 00 00 02 65 02
      15 01 00 00 00 00 02 66 02
      15 01 00 00 00 00 02 67 02
      15 01 00 00 00 00 02 68 02
      15 01 00 00 00 00 02 69 02
      15 01 00 00 00 00 02 6a 02
      15 01 00 00 00 00 02 6b 02
      15 01 00 00 00 00 02 6c 02
      15 01 00 00 00 00 02 6d 02
      15 01 00 00 00 00 02 6e 02
      15 01 00 00 00 00 02 6f 02
      15 01 00 00 00 00 02 70 02
      15 01 00 00 00 00 02 71 06
      15 01 00 00 00 00 02 72 07
      15 01 00 00 00 00 02 73 02
      15 01 00 00 00 00 02 74 02
      15 01 00 00 00 00 02 75 06
      15 01 00 00 00 00 02 76 07
      15 01 00 00 00 00 02 77 0E
      15 01 00 00 00 00 02 78 0F
      15 01 00 00 00 00 02 79 0C
      15 01 00 00 00 00 02 7a 0D
      15 01 00 00 00 00 02 7b 02
      15 01 00 00 00 00 02 7c 02
      15 01 00 00 00 00 02 7d 02
      15 01 00 00 00 00 02 7e 02
      15 01 00 00 00 00 02 7f 02
      15 01 00 00 00 00 02 80 02
      15 01 00 00 00 00 02 81 02
      15 01 00 00 00 00 02 82 02
      15 01 00 00 00 00 02 83 02
      15 01 00 00 00 00 02 84 02
      15 01 00 00 00 00 02 85 02
      15 01 00 00 00 00 02 86 02
      15 01 00 00 00 00 02 87 09
      15 01 00 00 00 00 02 88 08
      15 01 00 00 00 00 02 89 02
      15 01 00 00 00 00 02 8A 02
           
			39 01 00 00 00 00 04  FF   98 81 04  
			15 01 00 00 00 00 02  6C   15            
			15 01 00 00 00 00 02  6E   2A            
			15 01 00 00 00 00 02  6F   35 
			15 01 00 00 00 00 02  3A   A4            
			15 01 00 00 00 00 02  8D   1A            
			15 01 00 00 00 00 02  87   BA            
			15 01 00 00 00 00 02  26   76            
			15 01 00 00 00 00 02  B2   D1            
         
			
			           
			39 01 00 00 00 00 04 FF 98 81 01  
			15 01 00 00 00 00 02 22 09
      15 01 00 00 00 00 02 31 00
      15 01 00 00 00 00 02 53 20
      15 01 00 00 00 00 02 55 20
      15 01 00 00 00 00 02 50 AF
      15 01 00 00 00 00 02 51 AF
      15 01 00 00 00 00 02 60 14
          
      15 01 00 00 00 00 02 A0 08
      15 01 00 00 00 00 02 A1 13
      15 01 00 00 00 00 02 A2 25
      15 01 00 00 00 00 02 A3 10
      15 01 00 00 00 00 02 A4 17
      15 01 00 00 00 00 02 A5 2D
      15 01 00 00 00 00 02 A6 22    
      15 01 00 00 00 00 02 A7 22     
      15 01 00 00 00 00 02 A8 9A
      15 01 00 00 00 00 02 A9 1A
      15 01 00 00 00 00 02 AA 26
      15 01 00 00 00 00 02 AB 82
      15 01 00 00 00 00 02 AC 17
      15 01 00 00 00 00 02 AD 15
      15 01 00 00 00 00 02 AE 4B
      15 01 00 00 00 00 02 AF 1E
      15 01 00 00 00 00 02 B0 25
      15 01 00 00 00 00 02 B1 54
      15 01 00 00 00 00 02 B2 64
      15 01 00 00 00 00 02 B3 39
          
      15 01 00 00 00 00 02 C0 08
      15 01 00 00 00 00 02 C1 25
      15 01 00 00 00 00 02 C2 35
      15 01 00 00 00 00 02 C3 18
      15 01 00 00 00 00 02 C4 1B
      15 01 00 00 00 00 02 C5 2F
      15 01 00 00 00 00 02 C6 25
      15 01 00 00 00 00 02 C7 25
      15 01 00 00 00 00 02 C8 AE
      15 01 00 00 00 00 02 C9 1F
      15 01 00 00 00 00 02 CA 2B
      15 01 00 00 00 00 02 CB 8C
      15 01 00 00 00 00 02 CC 1A
      15 01 00 00 00 00 02 CD 1A
      15 01 00 00 00 00 02 CE 4D
      15 01 00 00 00 00 02 CF 25
      15 01 00 00 00 00 02 D0 2B
      15 01 00 00 00 00 02 D1 56
      15 01 00 00 00 00 02 D2 67
      15 01 00 00 00 00 02 D3 39 
               
			39 01 00 00 00 00 04 FF 98 81 00  
			15 01 00 00 00 00 02 35 00            
			05 01 00 00 78 00 02 11 00
			05 01 00 00 28 00 02 29 00];
		qcom,mdss-dsi-off-command = [05 01 00 00 14 00 02 28 00
				 05 01 00 00 78 00 02 10 00];
		qcom,mdss-dsi-on-command-state = "dsi_lp_mode";
		qcom,mdss-dsi-off-command-state = "dsi_hs_mode";
		qcom,mdss-dsi-bl-pmic-control-type = "bl_ctrl_wled";
		qcom,mdss-dsi-reset-sequence = <1 10>, <0 10>, <1 10>;
		qcom,mdss-dsi-tx-eot-append;
		qcom,mdss-dsi-lp11-init;
		qcom,mdss-dsi-post-init-delay = <1>;
	};
};
