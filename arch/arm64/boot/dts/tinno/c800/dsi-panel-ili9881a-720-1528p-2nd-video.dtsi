/* Copyright (c) 2015-2016, The Linux Foundation. All rights reserved.
 *
 * This program is free software; you can redistribute it and/or modify
 * it under the terms of the GNU General Public License version 2 and
 * only version 2 as published by the Free Software Foundation.
 *
 * This program is distributed in the hope that it will be useful,
 * but WITHOUT ANY WARRANTY; without even the implied warranty of
 * MERCHANTABILITY or FITNESS FOR A PARTICULAR PURPOSE.  See the
 * GNU General Public License for more details.
 */

&mdss_mdp {
	dsi_ili9881a_720_1528_2nd_vid: qcom,mdss_dsi_ili9881a_720_1528p_2nd_video {
		qcom,mdss-dsi-panel-name = "ili9881a 720 1528p video mode dsi panel";
		qcom,mdss-dsi-panel-controller = <&mdss_dsi0>;
		qcom,mdss-dsi-panel-destination = "display_1";
		qcom,mdss-dsi-panel-type = "dsi_video_mode";
		qcom,mdss-dsi-panel-framerate = <60>;
		qcom,mdss-dsi-virtual-channel-id = <0>;
		qcom,mdss-dsi-stream = <0>;
		qcom,mdss-dsi-panel-width = <720>;
		qcom,mdss-dsi-panel-height = <1528>;
		qcom,mdss-dsi-h-front-porch = <74>;
		qcom,mdss-dsi-h-back-porch = <72>;
		qcom,mdss-dsi-h-pulse-width = <28>;
		qcom,mdss-dsi-h-sync-skew = <0>;
		qcom,mdss-dsi-v-back-porch = <18>;
		qcom,mdss-dsi-v-front-porch = <27>;
		qcom,mdss-dsi-v-pulse-width = <12>;
		qcom,mdss-dsi-h-left-border = <0>;
		qcom,mdss-dsi-h-right-border = <0>;
		qcom,mdss-dsi-v-top-border = <0>;
		qcom,mdss-dsi-v-bottom-border = <0>;
		qcom,mdss-dsi-bpp = <24>;
		qcom,mdss-dsi-underflow-color = <0xff>;
		qcom,mdss-dsi-border-color = <0>;
		qcom,mdss-dsi-h-sync-pulse = <1>;
		qcom,mdss-dsi-traffic-mode = "burst_mode";
		qcom,mdss-dsi-bllp-eof-power-mode;
		qcom,mdss-dsi-bllp-power-mode;
		qcom,mdss-dsi-lane-map = "lane_map_0123";	
		qcom,mdss-dsi-lane-0-state;
		qcom,mdss-dsi-lane-1-state;
		qcom,mdss-dsi-lane-2-state;
		qcom,mdss-dsi-lane-3-state;
		qcom,mdss-dsi-panel-timings = [94 20 14 00 46 48 1A 24 18 03 04 00];// mipi clock rate = 510M
		qcom,mdss-dsi-t-clk-post = <0x04>;
		qcom,mdss-dsi-t-clk-pre = <0x1d>;
		
		qcom,mdss-dsi-bl-min-level = <1>;
		qcom,mdss-dsi-bl-max-level = <4095>;
		qcom,mdss-dsi-dma-trigger = "trigger_sw";
		qcom,mdss-dsi-mdp-trigger = "none";
		qcom,mdss-dsi-on-command = [
        39 01 00 00 00 00 04 FF 98 81 01
        39 01 00 00 00 00 02 01 00
        39 01 00 00 00 00 02 02 00
        39 01 00 00 00 00 02 03 73
        39 01 00 00 00 00 02 04 73
        39 01 00 00 00 00 02 05 00
        39 01 00 00 00 00 02 06 06
        39 01 00 00 00 00 02 07 02
        39 01 00 00 00 00 02 08 00
        39 01 00 00 00 00 02 09 00
        39 01 00 00 00 00 02 0a 00
        39 01 00 00 00 00 02 0b 00
        39 01 00 00 00 00 02 0c 00
        39 01 00 00 00 00 02 0d 00
        39 01 00 00 00 00 02 0e 00
        39 01 00 00 00 00 02 0f 00
        39 01 00 00 00 00 02 10 00
        39 01 00 00 00 00 02 11 00
        39 01 00 00 00 00 02 12 00
        39 01 00 00 00 00 02 13 00
        39 01 00 00 00 00 02 14 00
        39 01 00 00 00 00 02 15 00
        39 01 00 00 00 00 02 16 00
        39 01 00 00 00 00 02 17 00
        39 01 00 00 00 00 02 18 00
        39 01 00 00 00 00 02 19 00
        39 01 00 00 00 00 02 1a 00
        39 01 00 00 00 00 02 1b 00
        39 01 00 00 00 00 02 1c 00
        39 01 00 00 00 00 02 1d 00
        39 01 00 00 00 00 02 1e c0
        39 01 00 00 00 00 02 1f 00
        39 01 00 00 00 00 02 20 03
        39 01 00 00 00 00 02 21 04
        39 01 00 00 00 00 02 22 00
        39 01 00 00 00 00 02 23 00
        39 01 00 00 00 00 02 24 00
        39 01 00 00 00 00 02 25 00
        39 01 00 00 00 00 02 26 00
        39 01 00 00 00 00 02 27 00
        39 01 00 00 00 00 02 28 33
        39 01 00 00 00 00 02 29 02
        39 01 00 00 00 00 02 2a 00
        39 01 00 00 00 00 02 2b 00
        39 01 00 00 00 00 02 2c 00
        39 01 00 00 00 00 02 2d 00
        39 01 00 00 00 00 02 2e 00
        39 01 00 00 00 00 02 2f 00
        39 01 00 00 00 00 02 30 00
        39 01 00 00 00 00 02 31 00
        39 01 00 00 00 00 02 32 00
        39 01 00 00 00 00 02 33 00
        39 01 00 00 00 00 02 34 00
        39 01 00 00 00 00 02 35 00
        39 01 00 00 00 00 02 36 00
        39 01 00 00 00 00 02 37 00
        39 01 00 00 00 00 02 38 00
        39 01 00 00 00 00 02 39 07
        39 01 00 00 00 00 02 3a 00
        39 01 00 00 00 00 02 3b 00
        39 01 00 00 00 00 02 3c 00
        39 01 00 00 00 00 02 3d 00
        39 01 00 00 00 00 02 3e 00
        39 01 00 00 00 00 02 3f 00
        39 01 00 00 00 00 02 40 00
        39 01 00 00 00 00 02 41 88
        39 01 00 00 00 00 02 42 00
        39 01 00 00 00 00 02 43 40
        39 01 00 00 00 00 02 44 04
        39 01 00 00 00 00 02 45 00
        39 01 00 00 00 00 02 46 00
        39 01 00 00 00 00 02 47 08
        39 01 00 00 00 00 02 48 00
        39 01 00 00 00 00 02 49 00
        39 01 00 00 00 00 02 4a 00
        39 01 00 00 00 00 02 4b 00
        39 01 00 00 00 00 02 4c 86
        39 01 00 00 00 00 02 4d a8
        39 01 00 00 00 00 02 4e 64
        39 01 00 00 00 00 02 4f 22
        39 01 00 00 00 00 02 50 22
        39 01 00 00 00 00 02 51 22
        39 01 00 00 00 00 02 52 22
        39 01 00 00 00 00 02 53 22
        39 01 00 00 00 00 02 54 22
        39 01 00 00 00 00 02 55 ac
        39 01 00 00 00 00 02 56 22
        39 01 00 00 00 00 02 57 97
        39 01 00 00 00 00 02 58 B9
        39 01 00 00 00 00 02 59 75
        39 01 00 00 00 00 02 5a 22
        39 01 00 00 00 00 02 5b 22
        39 01 00 00 00 00 02 5c 22
        39 01 00 00 00 00 02 5d 22
        39 01 00 00 00 00 02 5e 22
        39 01 00 00 00 00 02 5f 22
        39 01 00 00 00 00 02 60 bd
        39 01 00 00 00 00 02 61 22
        39 01 00 00 00 00 02 62 06
        39 01 00 00 00 00 02 63 0d
        39 01 00 00 00 00 02 64 0b
        39 01 00 00 00 00 02 65 5b
        39 01 00 00 00 00 02 66 59
        39 01 00 00 00 00 02 67 57
        39 01 00 00 00 00 02 68 55
        39 01 00 00 00 00 02 69 02
        39 01 00 00 00 00 02 6a 02
        39 01 00 00 00 00 02 6b 02
        39 01 00 00 00 00 02 6c 02
        39 01 00 00 00 00 02 6d 02
        39 01 00 00 00 00 02 6e 02
        39 01 00 00 00 00 02 6f 02
        39 01 00 00 00 00 02 70 02
        39 01 00 00 00 00 02 71 02
        39 01 00 00 00 00 02 72 02
        39 01 00 00 00 00 02 73 02
        39 01 00 00 00 00 02 74 02
        39 01 00 00 00 00 02 75 07
        39 01 00 00 00 00 02 76 09
        39 01 00 00 00 00 02 77 02
        39 01 00 00 00 00 02 78 02
        39 01 00 00 00 00 02 79 0c
        39 01 00 00 00 00 02 7a 0a
        39 01 00 00 00 00 02 7b 5a
        39 01 00 00 00 00 02 7c 58
        39 01 00 00 00 00 02 7d 56
        39 01 00 00 00 00 02 7e 54
        39 01 00 00 00 00 02 7f 02
        39 01 00 00 00 00 02 80 02
        39 01 00 00 00 00 02 81 02
        39 01 00 00 00 00 02 82 02
        39 01 00 00 00 00 02 83 02
        39 01 00 00 00 00 02 84 02
        39 01 00 00 00 00 02 85 02
        39 01 00 00 00 00 02 86 02
        39 01 00 00 00 00 02 87 02
        39 01 00 00 00 00 02 88 02
        39 01 00 00 00 00 02 89 02
        39 01 00 00 00 00 02 8a 02
        39 01 00 00 00 00 02 8b 06
        39 01 00 00 00 00 02 8c 08
        39 01 00 00 00 00 02 8d 02
        39 01 00 00 00 00 02 8e 02
        39 01 00 00 00 00 02 8f 00
        39 01 00 00 00 00 02 90 00
        39 01 00 00 00 00 04 FF 98 81 02
        39 01 00 00 00 00 02 08 22
        39 01 00 00 00 00 02 15 10
        39 01 00 00 00 00 02 57 00
        39 01 00 00 00 00 02 58 28
        39 01 00 00 00 00 02 59 3D
        39 01 00 00 00 00 02 5A 18
        39 01 00 00 00 00 02 5B 20
        39 01 00 00 00 00 02 5C 36
        39 01 00 00 00 00 02 5D 29
        39 01 00 00 00 00 02 5E 27
        39 01 00 00 00 00 02 5F C1
        39 01 00 00 00 00 02 60 1C
        39 01 00 00 00 00 02 61 27
        39 01 00 00 00 00 02 62 9C
        39 01 00 00 00 00 02 63 1B
        39 01 00 00 00 00 02 64 1A
        39 01 00 00 00 00 02 65 4F
        39 01 00 00 00 00 02 66 24
        39 01 00 00 00 00 02 67 29
        39 01 00 00 00 00 02 68 57
        39 01 00 00 00 00 02 69 65
        39 01 00 00 00 00 02 6A 35
        39 01 00 00 00 00 02 6B 00
        39 01 00 00 00 00 02 6C 28
        39 01 00 00 00 00 02 6D 3D
        39 01 00 00 00 00 02 6E 18
        39 01 00 00 00 00 02 6F 20
        39 01 00 00 00 00 02 70 36
        39 01 00 00 00 00 02 71 29
        39 01 00 00 00 00 02 72 27
        39 01 00 00 00 00 02 73 C1
        39 01 00 00 00 00 02 74 1C
        39 01 00 00 00 00 02 75 27
        39 01 00 00 00 00 02 76 9C
        39 01 00 00 00 00 02 77 1B
        39 01 00 00 00 00 02 78 1A
        39 01 00 00 00 00 02 79 4F
        39 01 00 00 00 00 02 7A 24
        39 01 00 00 00 00 02 7B 29
        39 01 00 00 00 00 02 7C 57
        39 01 00 00 00 00 02 7D 65
        39 01 00 00 00 00 02 7E 35
        39 01 00 00 00 00 04 FF 98 81 05
        39 01 00 00 00 00 02 30 77
        39 01 00 00 00 00 02 54 39
        39 01 00 00 00 00 02 55 1F
        39 01 00 00 00 00 02 56 8C
        39 01 00 00 00 00 02 57 8C
        39 01 00 00 00 00 02 04 4A
        39 01 00 00 00 00 02 06 4A
        39 01 00 00 00 00 04 FF 98 81 06
        39 01 00 00 00 00 02 c0 fb
        39 01 00 00 00 00 02 c1 2a
        39 01 00 00 00 00 04 FF 98 81 00
        39 01 00 00 00 00 02 35 00
        39 01 00 00 00 00 02 36 0A
        39 01 00 00 64 00 02 11 00
        39 01 00 00 0a 00 02 29 00
        39 01 00 00 00 00 04 FF 98 81 09
        39 01 00 00 00 00 02 80 00
];      
        	qcom,mdss-dsi-off-command = [39 01 00 00 00 00 04 FF 98 81 01
         		39 01 00 00 00 00 02 B3 3F
         		39 01 00 00 00 00 02 D3 3F
         		39 01 00 00 00 00 04 FF 98 81 04
         		39 01 00 00 00 00 02 2D 02
         		39 01 00 00 64 00 02 2F 01
         		39 01 00 00 00 00 02 2F 00
         		39 01 00 00 00 00 04 FF 98 81 00
         		05 01 00 00 0A 00 02 28 00
         		05 01 00 00 78 00 02 10 00
         		39 01 00 00 00 00 04 FF 98 81 00
         		39 01 00 00 00 00 02 58 01];     
		
		qcom,mdss-dsi-on-command-state = "dsi_lp_mode";
		qcom,mdss-dsi-off-command-state = "dsi_lp_mode";
		
		qcom,esd-check-enabled;
//		qcom,mdss-dsi-panel-status-check-mode = "bta_check";
//		qcom,mdss-dsi-panel-status-command = [06 01 00 01 05 00 02 0A 08];
//		qcom,mdss-dsi-panel-status-command-state = "dsi_hs_mode";
//		qcom,mdss-dsi-panel-status-check-mode = "reg_read";
//		qcom,mdss-dsi-panel-status-read-length = <1>;
//		qcom,mdss-dsi-panel-status-value = <0x1c>;
		
		qcom,mdss-dsi-bl-pmic-control-type = "bl_ctrl_wled";
		qcom,mdss-dsi-lp11-init;
		qcom,mdss-dsi-reset-sequence = <1 2>, <0 10>, <1 50>;
		qcom,mdss-dsi-tx-eot-append;
		//qcom,mdss-dsi-post-init-delay = <50>;

		qcom,mdss-pan-physical-width-dimension = <64>;
		qcom,mdss-pan-physical-height-dimension = <137>; //modify to 64*137
	};
};






























































































































































































